## external/configs/serial_defconfig
```kconfig
BR2_x86_i686=y
BR2_CCACHE=y
BR2_TOOLCHAIN_BUILDROOT_INET_RPC=y
BR2_TARGET_GENERIC_HOSTNAME="areyouforserial"
BR2_TARGET_GENERIC_ISSUE="Welcome to the buggy serial device quarantine"
BR2_TARGET_GENERIC_ROOT_PASSWD="root"
BR2_TARGET_GENERIC_GETTY_OPTIONS="-n"
BR2_SYSTEM_DHCP="eth0"
BR2_ROOTFS_OVERLAY="$(BR2_EXTERNAL)/overlay/"
BR2_LINUX_KERNEL=y
BR2_LINUX_KERNEL_USE_CUSTOM_CONFIG=y
BR2_LINUX_KERNEL_CUSTOM_CONFIG_FILE="$(BR2_EXTERNAL)/configs/kernel.config"
BR2_PACKAGE_BUSYBOX_CONFIG="$(BR2_EXTERNAL)/configs/busybox.config"
BR2_PACKAGE_STRACE=y
BR2_PACKAGE_PICOCOM=y
BR2_PACKAGE_SETSERIAL=y
BR2_TARGET_ROOTFS_INITRAMFS=y
# BR2_TARGET_ROOTFS_TAR is not set
BR2_TARGET_GRUB2=y
```
